## dts/bindings/power/st,stm32h5-iocell.yaml
```yaml
# Copyright (c) 2026 CodeWrights GmbH
# SPDX-License-Identifier: Apache-2.0

description: STM32H5 I/O cell controller

compatible: "st,stm32h5-iocell"

include:
  - name: st,stm32-iocell.yaml
    property-blocklist:
      - hslv-mode
```
